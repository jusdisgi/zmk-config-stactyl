/*
 * Copyright (c) 2026 Hunter Cook (jusdisgi)
 * SPDX-License-Identifier: MIT
 *
 * Left half = split CENTRAL. Matrix columns 0..4 (C0 pinky .. C4 inner).
 *
 * !! PLACEHOLDER PINS !! These xiao_d column pins are tentative — stactyl's PCB
 * isn't routed, so there are no pin assignments in ../stactyl/config.yaml to
 * mirror yet. Once routed, re-derive every col pin from the XIAO Plus footprint
 * Pn: assignments and replace these. The key-position ORDER is final; only the
 * specific xiao_d pins are tentative.
 */

#include "stactyl.dtsi"

&kscan0 {
    col-gpios
        = <&xiao_d 4 GPIO_ACTIVE_HIGH>   /* C0 pinky  */
        , <&xiao_d 5 GPIO_ACTIVE_HIGH>   /* C1 ring   */
        , <&xiao_d 6 GPIO_ACTIVE_HIGH>   /* C2 middle */
        , <&xiao_d 7 GPIO_ACTIVE_HIGH>   /* C3 index  */
        , <&xiao_d 8 GPIO_ACTIVE_HIGH>   /* C4 inner  */
        ;
};

## config/boards/shields/stactyl/Kconfig.defconfig
```kconfig
# Copyright (c) 2026 Hunter Cook (jusdisgi)
# SPDX-License-Identifier: MIT

if SHIELD_STACTYL_LEFT

config ZMK_KEYBOARD_NAME
    default "stactyl"

config ZMK_SPLIT_ROLE_CENTRAL
    default y

endif

if SHIELD_STACTYL_LEFT || SHIELD_STACTYL_RIGHT

config ZMK_SPLIT
    default y

endif
```

## config/boards/shields/stactyl/Kconfig.shield
```kconfig
# Copyright (c) 2026 Hunter Cook (jusdisgi)
# SPDX-License-Identifier: MIT

config SHIELD_STACTYL_LEFT
    def_bool $(shields_list_contains,stactyl_left)

config SHIELD_STACTYL_RIGHT
    def_bool $(shields_list_contains,stactyl_right)
```

## config/west.yml
```yaml
manifest:
  remotes:
    - name: zmkfirmware
      url-base: https://github.com/zmkfirmware
  projects:
    - name: zmk
      remote: zmkfirmware
      revision: 773dec58eaacaef4703b3e4595e50bd71f6cad3d
      import: app/west.yml
  self:
    path: config
```

/*
 * Copyright (c) 2026 Hunter Cook (jusdisgi)
 * SPDX-License-Identifier: MIT
 *
 * Right half = split PERIPHERAL. col-offset shifts its 5 columns into 5..9 of
 * the transform. The col-gpios are listed in REVERSED order vs the left so the
 * mirrored column lands at the right visual position (right physical C4 inner ->
 * transform col 5, ... right physical C0 pinky -> transform col 9).
 *
 * !! PLACEHOLDER PINS !! Same caveat as stactyl_left.overlay — re-derive from
 * the routed PCB. The right PCB uses the same per-half pin->column wiring as the
 * left; only the listing order is reversed here for the mirror.
 */

#include "stactyl.dtsi"

&default_transform {
    col-offset = <5>;
};

&kscan0 {
    col-gpios
        = <&xiao_d 8 GPIO_ACTIVE_HIGH>   /* C4 inner  -> col 5 */
        , <&xiao_d 7 GPIO_ACTIVE_HIGH>   /* C3 index  -> col 6 */
        , <&xiao_d 6 GPIO_ACTIVE_HIGH>   /* C2 middle -> col 7 */
        , <&xiao_d 5 GPIO_ACTIVE_HIGH>   /* C1 ring   -> col 8 */
        , <&xiao_d 4 GPIO_ACTIVE_HIGH>   /* C0 pinky  -> col 9 */
        ;
};
